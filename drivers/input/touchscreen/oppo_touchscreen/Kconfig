## drivers/input/touchscreen/oppo_touchscreen/Kconfig
```kconfig
config TOUCHPANEL_MTK_PLATFORM
	bool "OPPO platform tp module used"
	help
	  Say Y here if you have mtk-platform.

config TOUCHPANEL_NEW_SET_IRQ_WAKE
	bool "OPPO platform tp module used"
	help
	  Say Y here if call enable_irq_wake, can not call disable_irq_nosync

config TOUCHPANEL_OPPO
	bool "OPPO tp module"
	help
	  Say Y here if you have touchscreen module.

config TOUCHPANEL_SYNAPTICS
#	default y
	bool "TP Synaptics_IC enable or not for OPPO"
	---help---
	say Y to enable driver for Touchpanel using Synaptics_IC

source "drivers/input/touchscreen/oppo_touchscreen/util_interface/Kconfig"

if TOUCHPANEL_SYNAPTICS
source "drivers/input/touchscreen/oppo_touchscreen/Synaptics/Kconfig"
endif
```
